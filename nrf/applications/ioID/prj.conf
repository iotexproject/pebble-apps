## CMakeLists.txt
```
#
# Copyright (c) 2018 Nordic Semiconductor
#
# SPDX-License-Identifier: LicenseRef-BSD-5-Clause-Nordic
#

cmake_minimum_required(VERSION 3.8.2)

set(PM_STATIC_YML_FILE ${CMAKE_CURRENT_SOURCE_DIR}/configuration/${BOARD}/pm_static.yml)

find_package(Zephyr REQUIRED HINTS $ENV{ZEPHYR_BASE})
project(asset_tracker)
zephyr_compile_definitions(PROJECT_NAME=${PROJECT_NAME})
zephyr_compile_definitions(_POSIX_C_SOURCE=200809L)

get_target_property(TFM_BINARY_DIR tfm TFM_BINARY_DIR)
configure_file(
  ${CMAKE_CURRENT_LIST_DIR}/secure_peripheral_partition/tfm_manifest_list.yaml.in
  ${CMAKE_CURRENT_BINARY_DIR}/secure_peripheral_partition/tfm_manifest_list.yaml
)

set_property(TARGET zephyr_property_target
  APPEND PROPERTY TFM_CMAKE_OPTIONS
  -DTFM_EXTRA_MANIFEST_LIST_FILES=${CMAKE_CURRENT_BINARY_DIR}/secure_peripheral_partition/tfm_manifest_list.yaml
  -DTFM_EXTRA_PARTITION_PATHS=${CMAKE_CURRENT_LIST_DIR}/secure_peripheral_partition
)

add_compile_options(-w)

# NORDIC SDK APP START
target_sources(app PRIVATE src/main.c)
# BME680
target_sources(app PRIVATE src/bme/bme680.c)
target_sources(app PRIVATE src/bme/bme680_helper.c)

# HAL
target_sources(app PRIVATE src/hal/hal_adc.c)
target_sources(app PRIVATE src/hal/hal_gpio.c)

# Modem
target_sources(app PRIVATE src/modem/modem_helper.c)
target_sources(app PRIVATE src/modem/modemStorage.c)
# MQTT
target_sources(app PRIVATE src/mqtt/mqtt.c)
target_sources(app PRIVATE src/mqtt/config.c)
target_sources(app PRIVATE src/mqtt/payload.c)
target_sources(app PRIVATE src/mqtt/devReg.c)
# Protbuf
target_sources(app PRIVATE src/nanopb/pb_encode.c)
target_sources(app PRIVATE src/nanopb/pb_decode.c)
target_sources(app PRIVATE src/nanopb/pb_common.c)
target_sources(app PRIVATE src/nanopb/package.pb.c)
# Local NVS
target_sources(app PRIVATE src/nvs/local_storage.c)
# Signature 
target_sources(app PRIVATE src/sign/ecdsa.c)
target_sources(app PRIVATE src/sign/secure_peripheral_partition.c)
# OTA
target_sources(app PRIVATE src/ota/http_update.c)
target_sources(app PRIVATE src/time/ntp.c)

target_sources(app PRIVATE src/light_sensor/tsl2572.c)

# NORDIC SDK APP END
zephyr_include_directories(src)

# Include application events and configuration headers
zephyr_library_include_directories(
  src/ui
  src/nanopb
  src/mqtt
  src/light_sensor
  src/watchdog
  src/sign
  src/icm
  src/ioConnect_core/src
  src/ioConnect_pal
  )

# Application sources
add_subdirectory(src/ui)
add_subdirectory(src/gps_controller)
add_subdirectory_ifdef(CONFIG_WATCHDOG src/watchdog)
add_subdirectory(src/icm)
add_subdirectory(src/ioConnect_core)
add_subdirectory(src/ioConnect_pal)

target_include_directories(app PRIVATE
  $<TARGET_PROPERTY:tfm,TFM_BINARY_DIR>/install/interface/include
)

target_compile_definitions(app
    PRIVATE TFM_PARTITION_SECURE_PERIPHERAL_PARTITION
)

if (CONFIG_USE_BME680_BSEC)
  target_link_libraries(app PUBLIC bsec_lib)
endif()
```

## sample.yaml
```
sample:
  name: Asset Tracker v2 Application
common:
  integration_platforms:
    - iotex_pebble_hw30ns
tests:
  applications.asset_tracker_v2.nrf_cloud:
    build_only: true
    build_on_all: true
    platform_allow: iotex_pebble_hw30ns
    tags: ci_build
  applications.asset_tracker_v2.nrf_cloud-pgps:
    build_only: true
    build_on_all: true
    platform_allow: iotex_pebble_hw30ns
    extra_args: OVERLAY_CONFIG=overlay-pgps.conf
    tags: ci_build
  applications.asset_tracker_v2.aws:
    build_only: true
    build_on_all: true
    platform_allow: iotex_pebble_hw30ns
    extra_configs:
      - CONFIG_AWS_IOT_BROKER_HOST_NAME="example-hostname.aws.com"
    extra_args: OVERLAY_CONFIG="overlay-aws.conf"
    tags: ci_build
  applications.asset_tracker_v2.aws-pgps:
    build_only: true
    build_on_all: true
    platform_allow: iotex_pebble_hw30ns
    extra_configs:
      - CONFIG_AWS_IOT_BROKER_HOST_NAME="example-hostname.aws.com"
    extra_args: OVERLAY_CONFIG="overlay-aws.conf;overlay-pgps.conf"
    tags: ci_build
  applications.asset_tracker_v2.aws-all:
    build_only: true
    build_on_all: true
    platform_allow: iotex_pebble_hw30ns
    extra_configs:
      - CONFIG_AWS_IOT_BROKER_HOST_NAME="example-hostname.aws.com"
      - CONFIG_MEMFAULT_NCS_PROJECT_KEY="PROJECTKEY"
    extra_args: OVERLAY_CONFIG="overlay-aws.conf;overlay-pgps.conf;overlay-debug.conf;overlay-memfault.conf"
    tags: ci_build
  applications.asset_tracker_v2.azure:
    build_only: true
    build_on_all: true
    platform_allow: iotex_pebble_hw30ns
    extra_configs:
      - CONFIG_AZURE_IOT_HUB_DPS_HOSTNAME="global.azure-devices-provisioning.net"
      - CONFIG_AZURE_IOT_HUB_DPS_ID_SCOPE="IDSCOPE"
    extra_args: OVERLAY_CONFIG="overlay-azure.conf"
    tags: ci_build
  applications.asset_tracker_v2.debug:
    build_only: true
    build_on_all: true
    platform_allow: iotex_pebble_hw30ns
    extra_args: OVERLAY_CONFIG=overlay-debug.conf
    tags: ci_build
  applications.asset_tracker_v2.debug-memfault:
    build_only: true
    build_on_all: true
    platform_allow: iotex_pebble_hw30ns
    extra_configs:
      - CONFIG_MEMFAULT_NCS_PROJECT_KEY="PROJECTKEY"
    extra_args: OVERLAY_CONFIG="overlay-debug.conf;overlay-memfault.conf"
    tags: ci_build
  applications.asset_tracker_v2.memfault:
    build_only: true
    build_on_all: true
    platform_allow: iotex_pebble_hw30ns
    extra_configs:
      - CONFIG_MEMFAULT_NCS_PROJECT_KEY="PROJECTKEY"
    extra_args: OVERLAY_CONFIG=overlay-memfault.conf
    tags: ci_build
  applications.asset_tracker_v2.low-power:
    build_only: true
    build_on_all: true
    platform_allow: iotex_pebble_hw30ns
    extra_args: OVERLAY_CONFIG=overlay-low-power.conf
    tags: ci_build
  applications.asset_tracker_v2.carrier:
    build_only: true
    build_on_all: true
    platform_allow: iotex_pebble_hw30ns
    extra_args: OVERLAY_CONFIG=overlay-carrier.conf
    tags: ci_build
  applications.asset_tracker_v2.lwm2m.low-power:
    build_only: true
    build_on_all: true
    platform_allow: iotex_pebble_hw30ns
    extra_args: OVERLAY_CONFIG="overlay-lwm2m.conf;overlay-low-power.conf"
    tags: ci_build
  applications.asset_tracker_v2.lwm2m.debug:
    build_only: true
    build_on_all: true
    platform_allow: iotex_pebble_hw30ns
    extra_args: OVERLAY_CONFIG="overlay-lwm2m.conf;overlay-debug.conf"
    tags: ci_build
  applications.asset_tracker_v2.lwm2m.debug-modem_trace:
    build_only: true
    build_on_all: true
    platform_allow: iotex_pebble_hw30ns
    extra_configs:
      - CONFIG_NRF_MODEM_LIB_TRACE=y
    extra_args: OVERLAY_CONFIG="overlay-lwm2m.conf;overlay-debug.conf"
    tags: ci_build
  applications.asset_tracker_v2.lwm2m.debug-memfault:
    build_only: true
    build_on_all: true
    platform_allow: iotex_pebble_hw30ns
    extra_configs:
      - CONFIG_MEMFAULT_NCS_PROJECT_KEY="PROJECTKEY"
    extra_args: OVERLAY_CONFIG="overlay-lwm2m.conf;overlay-debug.conf;overlay-memfault.conf"
    tags: ci_build
  applications.asset_tracker_v2.memfault-low-power:
    build_only: true
    build_on_all: true
    platform_allow: iotex_pebble_hw30ns
    extra_configs:
      - CONFIG_MEMFAULT_NCS_PROJECT_KEY="PROJECTKEY"
    extra_args: OVERLAY_CONFIG="overlay-low-power.conf;overlay-memfault.conf"
    tags: ci_build
```

## prj.conf
```kconfig
#
# Copyright (c) 2019 Nordic Semiconductor ASA
#
# SPDX-License-Identifier: LicenseRef-BSD-5-Clause-Nordic
#
# General config
CONFIG_NEWLIB_LIBC=y
CONFIG_NEWLIB_LIBC_FLOAT_PRINTF=y
CONFIG_ASSERT=y
CONFIG_REBOOT=y
CONFIG_LOG=y
CONFIG_ADC=y
CONFIG_NVS=y
CONFIG_LOG_DEFAULT_LEVEL=3

# Network
CONFIG_NETWORKING=y
CONFIG_NET_NATIVE=n
CONFIG_NET_SOCKETS=y
CONFIG_NET_SOCKETS_OFFLOAD=y
CONFIG_NET_SOCKETS_POSIX_NAMES=y

# Modem library
CONFIG_NRF_MODEM_LIB=y
CONFIG_NRF_MODEM_LIB_SHMEM_TX_SIZE=22528
CONFIG_NRF_MODEM_LIB_SHMEM_RX_SIZE=8192
CONFIG_NRF_MODEM_LIB_ON_FAULT_APPLICATION_SPECIFIC=y
# Enable modem UART traces
CONFIG_NRF_MODEM_LIB_TRACE=n

# LTE link control
CONFIG_LTE_LINK_CONTROL=y
CONFIG_LTE_PSM_REQ=y
CONFIG_LTE_PSM_REQ_RPTAU="11000001"
CONFIG_LTE_PSM_REQ_RAT="00001010"

CONFIG_LTE_NETWORK_MODE_NBIOT=y
CONFIG_LTE_NETWORK_USE_FALLBACK=y
CONFIG_LTE_NETWORK_TIMEOUT=150

# Modem info
CONFIG_MODEM_INFO=y
CONFIG_MODEM_INFO_ADD_SIM_ICCID=n

# Needed for the cloud codec
# Shorter to prevent NAT timeouts
CONFIG_MQTT_KEEPALIVE=20
CONFIG_MQTT_LIB=y
CONFIG_MQTT_LIB_TLS=y

# Sensors
CONFIG_ACCEL_USE_EXTERNAL=y
CONFIG_ACCEL_DEV_NAME="ADXL362"
CONFIG_TEMP_USE_EXTERNAL=y
CONFIG_TEMP_DEV_NAME="BME680"

# Main thread
CONFIG_MAIN_THREAD_PRIORITY=7

# Heap and stacks
CONFIG_HEAP_MEM_POOL_SIZE=1024
CONFIG_MAIN_STACK_SIZE=8192
CONFIG_SYSTEM_WORKQUEUE_STACK_SIZE=2048
CONFIG_HW_STACK_PROTECTION=y

# Settings
CONFIG_FLASH=y
CONFIG_FLASH_PAGE_LAYOUT=y
CONFIG_FLASH_MAP=y
CONFIG_FCB=y
#CONFIG_SETTINGS=y
#CONFIG_SETTINGS_FCB=y
CONFIG_MPU_ALLOW_FLASH_WRITE=y

# MCUBOOT
CONFIG_BOOTLOADER_MCUBOOT=y
CONFIG_IMG_MANAGER=y
CONFIG_MCUBOOT_IMG_MANAGER=y
CONFIG_STREAM_FLASH=y
CONFIG_IMG_ERASE_PROGRESSIVELY=y

# AWS FOTA
CONFIG_AWS_FOTA=y
CONFIG_FOTA_DOWNLOAD=y
CONFIG_AWS_FOTA_LOG_LEVEL_DBG=y
CONFIG_AWS_JOBS_LOG_LEVEL_DBG=y
CONFIG_DFU_TARGET=y

# Download client (needed by AWS FOTA)
CONFIG_DOWNLOAD_CLIENT=y
CONFIG_DOWNLOAD_CLIENT_STACK_SIZE=4096

# Fatal error
CONFIG_RESET_ON_FATAL_ERROR=n

#watchdog
CONFIG_WATCHDOG=y

# mqtt and nv storage
CONFIG_MQTT_MESSAGE_BUFFER_SIZE=256
CONFIG_MQTT_PAYLOAD_BUFFER_SIZE=256
CONFIG_MQTT_BROKER_PORT=8883
CONFIG_MQTT_BROKER_HOSTNAME="a11homvea4zo8t-ats.iot.ap-east-1.amazonaws.com"
CONFIG_CLOUD_CERT_SEC_TAG=16842753
CONFIG_MQTT_CONFIG_DATA_CHANNEL=0x1ff7
CONFIG_MQTT_CONFIG_UPLOAD_PERIOD=30
CONFIG_NVS_LOCAL_STORAGE_SECTOR_COUNT=2
CONFIG_USE_PROVISIONED_CERTIFICATES=n
CONFIG_MODEM_KEY_MGMT=y
CONFIG_DOWNLOAD_HOST="pebble-ota.s3.ap-east-1.amazonaws.com"
CONFIG_DOWNLOAD_FILE="app_update.bin"
CONFIG_APPLICATION_VERSION=1
CONFIG_FOTA_DOWNLOAD_PROGRESS_EVT=y
CONFIG_DOWNLOAD_CLIENT_BUF_SIZE=2048
CONFIG_IOTEX_BOARD_VERSION=3
CONFIG_APP_VERSION="pebbleGo:1.2.0"
CONFIG_ASSET_TRACKER_WATCHDOG_TIMEOUT_MSEC=40000

# Enable ntp
# CONFIG_SNTP=y

# TF-M and mbedtls configure
CONFIG_TFM_PROFILE_TYPE_MEDIUM=y
CONFIG_NRF_SECURITY=y
CONFIG_MBEDTLS_PSA_CRYPTO_C=y
CONFIG_MBEDTLS_ENABLE_HEAP=y
CONFIG_MBEDTLS_HEAP_SIZE=8192

# TF-M code size
#CONFIG_PM_PARTITION_SIZE_TFM=0x2BE00

# Using hardware crypto accelerator
CONFIG_PSA_CRYPTO_DRIVER_OBERON=n
CONFIG_PSA_CRYPTO_DRIVER_CC3XX=y
CONFIG_TFM_LOG_LEVEL_SILENCE=y
CONFIG_UART_INTERRUPT_DRIVEN=y

# HTTP
CONFIG_HTTP_CLIENT=y

# CONFIG_NET_LOG=y
# CONFIG_NET_SOCKETS_LOG_LEVEL_DBG=n
# CONFIG_NET_HTTP_LOG_LEVEL_DBG=n

# CONFIG_MBEDTLS=y
# CONFIG_TLS_CREDENTIALS=y
```

## src/ver.h
```c
#ifndef __APP_VERSION__
#define __APP_VERSION__

/*  hardware board version */
#define HW_VERSION "3.0"

/*  nordic sdk version */
#define SDK_VERSION "2.4.0"

#define  IOTEX_APP_NAME  "Riverrock"

#define  RELEASE_VERSION    "2.1.1"

/*  application version */
#define IOTEX_APP_VERSION IOTEX_APP_NAME" "RELEASE_VERSION

#define APP_VERSION_INFO HW_VERSION"_"SDK_VERSION"_"IOTEX_APP_VERSION">"

/*  upload period, second */
#define SENSOR_UPLOAD_PERIOD       300

#endif /*  #ifndef __APP_VERSION__ */
```
