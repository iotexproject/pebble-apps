## prj.conf
```kconfig
#
# Copyright (c) 2019 Nordic Semiconductor ASA
#
# SPDX-License-Identifier: LicenseRef-BSD-5-Clause-Nordic
#
# General config
CONFIG_NEWLIB_LIBC=y
CONFIG_NEWLIB_LIBC_FLOAT_PRINTF=y
CONFIG_ASSERT=y
CONFIG_REBOOT=y
CONFIG_LOG=y
CONFIG_ADC=y
CONFIG_NVS=y
CONFIG_LOG_DEFAULT_LEVEL=3

# Network
CONFIG_NETWORKING=y
CONFIG_NET_NATIVE=n
CONFIG_NET_SOCKETS=y
CONFIG_NET_SOCKETS_OFFLOAD=y

# Modem library
CONFIG_NRF_MODEM_LIB=y
CONFIG_NRF_MODEM_LIB_SHMEM_TX_SIZE=22528
CONFIG_NRF_MODEM_LIB_SHMEM_RX_SIZE=8192
CONFIG_NRF_MODEM_LIB_ON_FAULT_APPLICATION_SPECIFIC=y
# Enable modem UART traces
CONFIG_NRF_MODEM_LIB_TRACE=n

# LTE link control
CONFIG_LTE_LINK_CONTROL=y
CONFIG_LTE_PSM_REQ=y
CONFIG_LTE_PSM_REQ_RPTAU="11000001"
CONFIG_LTE_PSM_REQ_RAT="00001010"

CONFIG_LTE_NETWORK_MODE_NBIOT=y
CONFIG_LTE_NETWORK_USE_FALLBACK=y
CONFIG_LTE_NETWORK_TIMEOUT=150

# Modem info
CONFIG_MODEM_INFO=y
CONFIG_MODEM_INFO_ADD_SIM_ICCID=n

# Needed for the cloud codec
CONFIG_CJSON_LIB=y
# Shorter to prevent NAT timeouts
CONFIG_MQTT_KEEPALIVE=20
CONFIG_MQTT_LIB=y
CONFIG_MQTT_LIB_TLS=y

# Sensors
CONFIG_ACCEL_USE_EXTERNAL=y
CONFIG_ACCEL_DEV_NAME="ADXL362"
CONFIG_TEMP_USE_EXTERNAL=y
CONFIG_TEMP_DEV_NAME="BME680"

# Main thread
CONFIG_MAIN_THREAD_PRIORITY=7

# Heap and stacks
CONFIG_HEAP_MEM_POOL_SIZE=1024
CONFIG_MAIN_STACK_SIZE=8192
CONFIG_SYSTEM_WORKQUEUE_STACK_SIZE=2048
CONFIG_HW_STACK_PROTECTION=y

# Settings
CONFIG_FLASH=y
CONFIG_FLASH_PAGE_LAYOUT=y
CONFIG_FLASH_MAP=y
CONFIG_FCB=y
#CONFIG_SETTINGS=y
#CONFIG_SETTINGS_FCB=y
CONFIG_MPU_ALLOW_FLASH_WRITE=y

# MCUBOOT
CONFIG_BOOTLOADER_MCUBOOT=y
CONFIG_IMG_MANAGER=y
CONFIG_MCUBOOT_IMG_MANAGER=y
CONFIG_STREAM_FLASH=y
CONFIG_IMG_ERASE_PROGRESSIVELY=y

# AWS FOTA
CONFIG_AWS_FOTA=y
CONFIG_FOTA_DOWNLOAD=y
CONFIG_AWS_FOTA_LOG_LEVEL_DBG=y
CONFIG_AWS_JOBS_LOG_LEVEL_DBG=y
CONFIG_DFU_TARGET=y

# Download client (needed by AWS FOTA)
CONFIG_DOWNLOAD_CLIENT=y
CONFIG_DOWNLOAD_CLIENT_STACK_SIZE=4096

# Fatal error
CONFIG_RESET_ON_FATAL_ERROR=n

#watchdog
CONFIG_WATCHDOG=y

# mqtt and nv storage
CONFIG_MQTT_MESSAGE_BUFFER_SIZE=256
CONFIG_MQTT_PAYLOAD_BUFFER_SIZE=256
CONFIG_MQTT_BROKER_PORT=8883
CONFIG_MQTT_BROKER_HOSTNAME="a11homvea4zo8t-ats.iot.ap-east-1.amazonaws.com"
CONFIG_CLOUD_CERT_SEC_TAG=16842753
CONFIG_MQTT_CONFIG_DATA_CHANNEL=0x1ff7
CONFIG_MQTT_CONFIG_UPLOAD_PERIOD=30
CONFIG_NVS_LOCAL_STORAGE_SECTOR_COUNT=2
CONFIG_USE_PROVISIONED_CERTIFICATES=n
CONFIG_MODEM_KEY_MGMT=y
CONFIG_DOWNLOAD_HOST="pebble-ota.s3.ap-east-1.amazonaws.com"
CONFIG_DOWNLOAD_FILE="app_update.bin"
CONFIG_APPLICATION_VERSION=1
CONFIG_FOTA_DOWNLOAD_PROGRESS_EVT=y
CONFIG_DOWNLOAD_CLIENT_BUF_SIZE=2048
CONFIG_IOTEX_BOARD_VERSION=3
CONFIG_APP_VERSION="pebbleGo:1.2.0"
CONFIG_ASSET_TRACKER_WATCHDOG_TIMEOUT_MSEC=40000

# Enable ntp
CONFIG_SNTP=y

# TF-M and mbedtls configure
CONFIG_TFM_PROFILE_TYPE_MEDIUM=y
CONFIG_NRF_SECURITY=y
CONFIG_MBEDTLS_PSA_CRYPTO_C=y
CONFIG_MBEDTLS_ENABLE_HEAP=y
CONFIG_MBEDTLS_HEAP_SIZE=8192

# TF-M code size
CONFIG_PM_PARTITION_SIZE_TFM=0x2BE00

# Using hardware crypto accelerator
CONFIG_PSA_CRYPTO_DRIVER_OBERON=n
CONFIG_PSA_CRYPTO_DRIVER_CC3XX=y
CONFIG_TFM_LOG_LEVEL_SILENCE=y
CONFIG_UART_INTERRUPT_DRIVEN=y
```

## prj_iotex_pebble_hw30ns.conf
```kconfig
#
# Copyright (c) 2019 Nordic Semiconductor ASA
#
# SPDX-License-Identifier: LicenseRef-BSD-5-Clause-Nordic
#
# General config
CONFIG_NEWLIB_LIBC=y
CONFIG_NEWLIB_LIBC_FLOAT_PRINTF=y
CONFIG_ASSERT=y
CONFIG_REBOOT=y
CONFIG_LOG=y
CONFIG_LOG_IMMEDIATE=y
CONFIG_ADC=y
CONFIG_NVS=y
CONFIG_LOG_DEFAULT_LEVEL=3

# Network
CONFIG_NETWORKING=y
CONFIG_NET_NATIVE=n
CONFIG_NET_SOCKETS=y
CONFIG_NET_SOCKETS_OFFLOAD=y

# LTE link control
CONFIG_LTE_LINK_CONTROL=y
# CONFIG_LTE_AUTO_INIT_AND_CONNECT is not set
# CONFIG_LTE_LOCK_BANDS is not set
# CONFIG_LTE_LOCK_PLMN is not set
# CONFIG_LTE_UNLOCK_PLMN is not set

##CONFIG_LTE_PSM_REQ_RPTAU="00000011"
##CONFIG_LTE_PSM_REQ_RAT="00100001"
CONFIG_LTE_PSM_REQ_RPTAU="10101010"
CONFIG_LTE_PSM_REQ_RAT="00100000"
CONFIG_AT_HOST_LIBRARY=y

# CONFIG_LTE_EDRX_REQ is not set
CONFIG_LTE_EDRX_REQ_VALUE="1001"
CONFIG_LTE_LEGACY_PCO_MODE=y
# CONFIG_LTE_PDP_CMD is not set
# CONFIG_LTE_PDN_AUTH_CMD is not set
# CONFIG_LTE_NETWORK_MODE_LTE_M is not set
# CONFIG_LTE_NETWORK_MODE_LTE_M_GPS is not set
CONFIG_LTE_NETWORK_MODE_NBIOT=y
# CONFIG_LTE_NETWORK_MODE_NBIOT_GPS is not set
CONFIG_LTE_NETWORK_USE_FALLBACK=y
CONFIG_LTE_NETWORK_TIMEOUT=150
# CONFIG_FPROTECT is not set
CONFIG_AT_NOTIF=y
CONFIG_AT_NOTIF_SYS_INIT=y


# Modem info
CONFIG_MODEM_INFO=y
CONFIG_MODEM_INFO_ADD_SIM_ICCID=n

# BSD library
CONFIG_BSD_LIBRARY=y
CONFIG_BSD_LIBRARY_TRACE_ENABLED=n

# nRF Cloud
CONFIG_CLOUD_API=y
CONFIG_NRF_CLOUD=y
CONFIG_NRF_CLOUD_LOG_LEVEL_DBG=y
#CONFIG_NRF_CLOUD_AGPS=y
#CONFIG_NRF_CLOUD_CONNECTION_POLL_THREAD=y
#CONFIG_NRF_CLOUD_NONBLOCKING_SEND=y
# Needed for the cloud codec
CONFIG_CJSON_LIB=y
# Shorter to prevent NAT timeouts
CONFIG_MQTT_KEEPALIVE=20
# Don't resubscribe to topics if broker remembers them
#CONFIG_CLOUD_PERSISTENT_SESSIONS=y
CONFIG_MQTT_CLEAN_SESSION=y

# Sensors
CONFIG_SENSOR=y
CONFIG_ACCEL_USE_EXTERNAL=y
CONFIG_ACCEL_DEV_NAME="ADXL362"
#CONFIG_ADXL362=y
#CONFIG_ADXL362_TRIGGER_GLOBAL_THREAD=y
#CONFIG_ADXL362_ABS_REF_MODE=1
#CONFIG_ADXL362_ACTIVITY_THRESHOLD=200
#CONFIG_ADXL362_INACTIVITY_THRESHOLD=200
#CONFIG_ADXL362_INTERRUPT_MODE=1
CONFIG_TEMP_USE_EXTERNAL=y
CONFIG_TEMP_DEV_NAME="BME680"

# Deselect CONFIG_BME680 if CONFIG_USE_BME680_BSEC is selected
#CONFIG_BME680=y
#CONFIG_SPI_NRFX_SPIM_MISO_NO_PULL=y
#CONFIG_USE_BME680_BSEC=n

# GPS
#CONFIG_NRF9160_GPS_LOG_LEVEL_DBG=y
#CONFIG_NRF9160_GPS=y
#CONFIG_NRF9160_GPS_LOG_LEVEL_DBG=y
#CONFIG_GPS_USE_EXTERNAL=y
#CONFIG_GPS_DEV_NAME="NRF9160_GPS"
#CONFIG_GPS_CONTROL_PSM_ENABLE_ON_START=y

#CONFIG_GPS_CONTROL_FIRST_FIX_CHECK_DELAY=10
#CONFIG_GPS_CONTROL_FIX_CHECK_INTERVAL=30
#CONFIG_GPS_CONTROL_FIX_TRY_TIME=360
#CONFIG_GPS_CONTROL_PSM_DISABLE_ON_STOP=n
#CONFIG_GPS_START_ON_MOTION=y

# Library for buttons and LEDs
CONFIG_DK_LIBRARY=y
CONFIG_DK_LIBRARY_INVERT_LEDS=n

# Console
#CONFIG_CLOUD_UA_BUTTONS=n
#CONFIG_CLOUD_UA_CONSOLE=n
CONFIG_CONSOLE_SUBSYS=y
CONFIG_CONSOLE_HANDLER=y
CONFIG_CONSOLE_GETCHAR=y

# Main thread
CONFIG_MAIN_THREAD_PRIORITY=7

# Heap and stacks
CONFIG_HEAP_MEM_POOL_SIZE=1024
CONFIG_MAIN_STACK_SIZE=8192
CONFIG_SYSTEM_WORKQUEUE_STACK_SIZE=2048
CONFIG_HW_STACK_PROTECTION=y

# Settings
CONFIG_FLASH=y
CONFIG_FLASH_PAGE_LAYOUT=y
CONFIG_FLASH_MAP=y
CONFIG_FCB=y
#CONFIG_SETTINGS=y
#CONFIG_SETTINGS_FCB=y
CONFIG_MPU_ALLOW_FLASH_WRITE=y

# MCUBOOT
CONFIG_BOOTLOADER_MCUBOOT=y
CONFIG_IMG_MANAGER=y
CONFIG_MCUBOOT_IMG_MANAGER=y
CONFIG_IMG_ERASE_PROGRESSIVELY=y

# AWS FOTA
CONFIG_AWS_FOTA=y
CONFIG_FOTA_DOWNLOAD=y
CONFIG_AWS_FOTA_LOG_LEVEL_DBG=y
CONFIG_AWS_JOBS_LOG_LEVEL_DBG=y
CONFIG_DFU_TARGET=y

# Download client (needed by AWS FOTA)
CONFIG_DOWNLOAD_CLIENT=y
CONFIG_DOWNLOAD_CLIENT_STACK_SIZE=4096

# Fatal error
CONFIG_RESET_ON_FATAL_ERROR=n

CONFIG_WATCHDOG=y

CONFIG_MQTT_MESSAGE_BUFFER_SIZE=256
CONFIG_MQTT_PAYLOAD_BUFFER_SIZE=256
#CONFIG_MQTT_BROKER_PORT=1884
CONFIG_MQTT_BROKER_PORT=8883
CONFIG_MQTT_BROKER_HOSTNAME="a11homvea4zo8t-ats.iot.ap-east-1.amazonaws.com"
#CONFIG_MQTT_BROKER_HOSTNAME="a38flh8hj8xizs-ats.iot.us-east-2.amazonaws.com"
#CONFIG_MQTT_BROKER_HOSTNAME="trypebble.io"
CONFIG_CLOUD_CERT_SEC_TAG=16842753
CONFIG_MQTT_CONFIG_DATA_CHANNEL=0x1ff7
CONFIG_MQTT_CONFIG_UPLOAD_PERIOD=30
CONFIG_NVS_LOCAL_STORAGE_SECTOR_COUNT=4
# CRYPTO
CONFIG_NORDIC_SECURITY_BACKEND=y
CONFIG_MBEDTLS=y
CONFIG_MBEDTLS_LIBRARY=y
CONFIG_ENTROPY_GENERATOR=y
CONFIG_MBEDTLS_ENABLE_HEAP=y
CONFIG_MBEDTLS_HEAP_SIZE=32768
CONFIG_MBEDTLS_CTR_DRBG_C=y
CONFIG_MBEDTLS_INSTALL_PATH="DUMMY"
CONFIG_SPEED_OPTIMIZATIONS=y
#CONFIG_NRF_CC310_PLATFORM=y

## EC
CONFIG_MBEDTLS_ECP_DP_SECP192R1_ENABLED=y
CONFIG_MBEDTLS_ECP_DP_SECP224R1_ENABLED=y
CONFIG_MBEDTLS_ECP_DP_SECP256R1_ENABLED=y
CONFIG_MBEDTLS_ECP_DP_SECP384R1_ENABLED=y
CONFIG_MBEDTLS_ECP_DP_SECP521R1_ENABLED=y
CONFIG_MBEDTLS_ECP_DP_SECP192K1_ENABLED=y
CONFIG_MBEDTLS_ECP_DP_SECP224K1_ENABLED=y
CONFIG_MBEDTLS_ECP_DP_SECP256K1_ENABLED=y

CONFIG_MBEDTLS_ECP_DP_CURVE25519_ENABLED=y

#I2C
CONFIG_I2C_1=y

#LOG
##CONFIG_PRINTK=y
##CONFIG_CONSOLE=y
#CONFIG_SERIAL=y
##CONFIG_STDOUT_CONSOLE=y
#CONFIG_UART_CONSOLE=n
##CONFIG_RTT_CONSOLE=y
##CONFIG_HAS_SEGGER_RTT=y
##CONFIG_USE_SEGGER_RTT=y
#CONFIG_NO_OPTIMIZATIONS=y 
CONFIG_MQTT_LOG_LEVEL_DBG=y
#CONFIG_MQTT_CONFIG_LOG_LEVEL_DBG=y
#CONFIG_MQTT_CONFIG_BULK_UPLOAD=y

#CONFIG_USE_PROVISIONED_CERTIFICATES=n
#CONFIG_MODEM_KEY_MGMT=y

#CONFIG_CC310_BACKEND=y
CONFIG_MBEDTLS_VANILLA_BACKEND=y
CONFIG_OBERON_BACKEND=n
CONFIG_VANILLA_MBEDTLS_AES_C=y

CONFIG_WATCHDOG=y

CONFIG_USE_PROVISIONED_CERTIFICATES=n
CONFIG_MODEM_KEY_MGMT=y

#CONFIG_USE_BME680_BSEC=y
#CONFIG_FP_HARDABI=y
#CONFIG_SETTINGS=y

CONFIG_DEPRECATED_ZEPHYR_INT_TYPES=y

#CONFIG_SECURE_BOOT=y
#CONFIG_MCUBOOT_SIGNATURE_KEY_FILE="root-sb.pem"
#CONFIG_BOOTLOADER_MCUBOOT=y
#CONFIG_BUILD_S1_VARIANT=y
#CONFIG_FW_INFO=y
#CONFIG_FW_INFO_FIRMWARE_VERSION=1
CONFIG_DOWNLOAD_HOST="pebble-ota.s3.ap-east-1.amazonaws.com"
CONFIG_DOWNLOAD_FILE="app_update.bin"
CONFIG_APPLICATION_VERSION=1
CONFIG_FOTA_DOWNLOAD_PROGRESS_EVT=y
CONFIG_DOWNLOAD_CLIENT_BUF_SIZE=2048



CONFIG_UI_LED_RED_PIN=16
CONFIG_UI_LED_GREEN_PIN=18
CONFIG_UI_LED_BLUE_PIN=17
CONFIG_UI_BUZZER_PIN=26

CONFIG_IOTEX_BOARD_VERSION=3
CONFIG_APP_VERSION="pebbleGo:1.2.0"

CONFIG_ASSET_TRACKER_WATCHDOG_TIMEOUT_MSEC=40000
CONFIG_SNTP=y
```

## src/main.c
```c
/*
 * Copyright (c) 2018 Nordic Semiconductor ASA
 *
 * SPDX-License-Identifier: LicenseRef-BSD-5-Clause-Nordic
 */
#include <zephyr/kernel.h>
#include <zephyr/kernel_structs.h>
#include <stdio.h>
#include <string.h>
#include <zephyr/drivers/sensor.h>
#include <zephyr/xen/console.h>
#include <zephyr/sys/reboot.h>
#include <zephyr/logging/log_ctrl.h>
#if defined(CONFIG_BSD_LIBRARY)
#include <modem/bsdlib.h>
#include <bsd.h>
#include <modem/lte_lc.h>
#include <modem/modem_info.h>
#endif /* CONFIG_BSD_LIBRARY */
#include <zephyr/net/socket.h>
#include <net/nrf_cloud.h>
#if defined(CONFIG_NRF_CLOUD_AGPS)
#include <net/nrf_cloud_agps.h>
#endif /* CONFIG_NRF_CLOUD_AGPS */
#include <zephyr/logging/log.h>
#if defined(CONFIG_LWM2M_CARRIER)
#include <lwm2m_carrier.h>
#endif /* CONFIG_LWM2M_CARRIER */
#if defined(CONFIG_BOOTLOADER_MCUBOOT)
#include <zephyr/dfu/mcuboot.h>
#endif /* CONFIG_BOOTLOADER_MCUBOOT */
#include <zephyr/drivers/pwm.h>
#include <modem/nrf_modem_lib.h>
#include <modem/at_monitor.h>
#include <modem/modem_info.h>
#include <modem/lte_lc.h>
#include "watchdog_app.h"
#include "gps_controller.h"

#include "mqtt/mqtt.h"
#include "mqtt/config.h"
#include "hal/hal_adc.h"
#include "hal/hal_gpio.h"
#include "nvs/local_storage.h"
#include "bme/bme680_helper.h"
#include "modem/modem_helper.h"
#include "icm/icm_chip_helper.h"
#include "ecdsa.h"
#include "light_sensor/tsl2572.h"
#include  "mqtt/devReg.h"
#include "display.h"
#include "ver.h"
#include "keyBoard.h"
#include "icm42605/icm426xx_pedometer.h"

#if !defined(CONFIG_USE_PROVISIONED_CERTIFICATES)
#if defined(CONFIG_MODEM_KEY_MGMT)
#include <modem/modem_key_mgmt.h>
#endif /* CONFIG_MODEM_KEY_MGMT */
#endif /* CONFIG_USE_PROVISIONED_CERTIFICATES */

LOG_MODULE_REGISTER(Riverrock_main, CONFIG_ASSET_TRACKER_LOG_LEVEL);

#if defined(CONFIG_BSD_LIBRARY) && !defined(CONFIG_LTE_LINK_CONTROL)
#error "Missing CONFIG_LTE_LINK_CONTROL"
#endif /* if defined(CONFIG_BSD_LIBRARY) && !defined(CONFIG_LTE_LINK_CONTROL) */

#if defined(CONFIG_BSD_LIBRARY) && defined(CONFIG_LTE_AUTO_INIT_AND_CONNECT) && defined(CONFIG_NRF_CLOUD_PROVISION_CERTIFICATES)
#error "PROVISION_CERTIFICATES \
    requires CONFIG_LTE_AUTO_INIT_AND_CONNECT to be disabled!"
#endif /* if defined(CONFIG_BSD_LIBRARY) && defined(CONFIG_LTE_AUTO_INIT_AND_CONNECT) && defined(CONFIG_NRF_CLOUD_PROVISION_CERTIFICATES) */

#define SUCCESS_OR_BREAK(rc) { if (rc != 0) { return ; } }

#if(CONFIG_IOTEX_BOARD_VERSION == 3)
Z_GENERIC_SECTION(.openocd_dbg.5) __attribute__((used)) const  uint8_t AppVersion[]= APP_VERSION_INFO;
#elif(CONFIG_IOTEX_BOARD_VERSION == 2)
Z_GENERIC_SECTION(.openocd_dbg.5) __attribute__((used)) const  uint8_t AppVersion[]=APP_VERSION_INFO;
#else
Z_GENERIC_SECTION(.openocd_dbg.5) __attribute__((used)) const  uint8_t AppVersion[]=APP_VERSION_INFO;
#endif /* CONFIG_IOTEX_BOARD_VERSION == 3 */

/* Stack definition for application workqueue */
K_THREAD_STACK_DEFINE(application_stack_area,CONFIG_APPLICATION_WORKQUEUE_STACK_SIZE);
static struct k_work_q application_work_q;
const uint8_t firmwareVersion[] = IOTEX_APP_VERSION;
/* File descriptor */
static struct pollfd fds;
/* MQTT Broker details. */
static struct mqtt_client client;
static atomic_val_t stopAnimation = ATOMIC_INIT(0);
static atomic_val_t keyWaitFlg = ATOMIC_INIT(0);
static k_tid_t mainThreadID;
static atomic_val_t pebbleStartup = ATOMIC_INIT(1);
extern atomic_val_t modemWriteProtect;
/* Structures for work */
static struct k_work_delayable send_env_data_work;
static struct k_work_delayable   animation_work;
enum error_type {
    ERROR_CLOUD,
    ERROR_BSD_RECOVERABLE,
    ERROR_LTE_LC,
    ERROR_SYSTEM_FAULT
};
static char mqttPubBuf[DATA_BUFFER_SIZE];
const char reconnectReminder[][4] = {
    "",
    "1st",
    "2nd",
    "3rd"
};
static void work_init(void);
static void periodic_publish_sensors_data(void);
static void sampling_and_store_sensor_data(void);

#if defined(CONFIG_NRF_MODEM_LIB)
NRF_MODEM_LIB_ON_INIT(pebble_init_hook, on_modem_lib_init, NULL);

/* Initialized to value different than success (0) */
static int modem_lib_init_result = -1;

static void on_modem_lib_init(int ret, void *ctx)
{
	modem_lib_init_result = ret;
}
#endif /* CONFIG_NRF_MODEM_LIB */
static const char *modem_crash_reason_get(uint32_t reason)
{
	switch (reason) {
	case NRF_MODEM_FAULT_UNDEFINED:
		return "Undefined fault";

	case NRF_MODEM_FAULT_HW_WD_RESET:
		return "HW WD reset";

	case NRF_MODEM_FAULT_HARDFAULT:
		return "Hard fault";

	case NRF_MODEM_FAULT_MEM_MANAGE:
		return "Memory management fault";

	case NRF_MODEM_FAULT_BUS:
		return "Bus fault";

	case NRF_MODEM_FAULT_USAGE:
		return "Usage fault";

	case NRF_MODEM_FAULT_SECURE_RESET:
		return "Secure control reset";

	case NRF_MODEM_FAULT_PANIC_DOUBLE:
		return "Error handler crash";

	case NRF_MODEM_FAULT_PANIC_RESET_LOOP:
		return "Reset loop";

	case NRF_MODEM_FAULT_ASSERT:
		return "Assert";

	case NRF_MODEM_FAULT_PANIC:
		return "Unconditional SW reset";

	case NRF_MODEM_FAULT_FLASH_ERASE:
		return "Flash erase fault";

	case NRF_MODEM_FAULT_FLASH_WRITE:
		return "Flash write fault";

	case NRF_MODEM_FAULT_POFWARN:
		return "Undervoltage fault";

	case NRF_MODEM_FAULT_THWARN:
		return "Overtemperature fault";

	default:
		return "Unknown reason";
	}
}
void nrf_modem_fault_handler(struct nrf_modem_fault_info *fault_info)
{
	printk("Modem crash reason: 0x%x (%s), PC: 0x%x\n",
		fault_info->reason,
		modem_crash_reason_get(fault_info->reason),
		fault_info->program_counter);

	__ASSERT(false, "Modem crash detected, halting application execution");
}

/**@brief nRF Cloud error handler. */
void error_handler(enum error_type err_type, int err_code)
{
    if (err_type == ERROR_CLOUD) {
        if (mqtt_disconnect(&client)) {
            LOG_ERR("Could not disconnect MQTT client during error handler.\n");
        }
        k_work_cancel_delayable(&send_env_data_work);
        return;
    }
}

/*  Upload sensor data */
static void uploadSensorData(void) {
    if (!atomic_get(&send_data_enable) || atomic_get(&pebbleStartup)) {
        return;
    }
    if (iotex_mqtt_is_bulk_upload()) {
        sampling_and_store_sensor_data();
    }
    else {
        periodic_publish_sensors_data();
    }
    pubOnePack();
}

/*  Restore work queue */
void RestartEnvWork(int s) {
    k_work_cancel_delayable(&send_env_data_work);
    k_work_reschedule(&send_env_data_work, K_SECONDS(s));
}

/*  mqtt cert write into modem */
void WriteCertIntoModem(uint8_t *cert, uint8_t *key, uint8_t *root ) {
    uint8_t *certificates[] = {root, key, cert};
    size_t cert_len[] = { strlen(root), strlen(key), strlen(cert) };
    int err;
    sec_tag_t sec_tag = CONFIG_CLOUD_CERT_SEC_TAG;
    enum modem_key_mgmt_cred_type cred[] = {
        MODEM_KEY_MGMT_CRED_TYPE_CA_CHAIN,
        MODEM_KEY_MGMT_CRED_TYPE_PRIVATE_CERT,
        MODEM_KEY_MGMT_CRED_TYPE_PUBLIC_CERT,
    };
    /* wait for modem flash writing over */
    if(atomic_get(&modemWriteProtect))
        return;

    disableModem();
    /* Delete certificates */
    for (enum modem_key_mgmt_cred_type type = 0; type < 3; type++) {
        err = modem_key_mgmt_delete(sec_tag, type);
        LOG_ERR("modem_key_mgmt_delete(%u, %d) => result=%d\n",
                sec_tag, type, err);
    }

    /* Write certificates */
    for (enum modem_key_mgmt_cred_type type = 0; type < 3; type++) {
        err = modem_key_mgmt_write(sec_tag, cred[type],
                certificates[type], cert_len[type]);
        LOG_ERR("modem_key_mgmt_write => result=%d\n", err);
    }
}

/*  Upload sensor data regularly */
static void periodic_publish_sensors_data(void) {
    int rc;
    SUCCESS_OR_BREAK(mqtt_ping(&client));
    if (rc = SensorPackage(iotex_mqtt_get_data_channel(), mqttPubBuf)) {
        rc = iotex_mqtt_publish_data(&client, 0, mqttPubBuf, rc);
        LOG_INF("mqtt_publish_devicedata: %d \n", rc);
    } else {
        LOG_ERR("mqtt package error ! \n");
    }
}

static void bulk_publish_sersor_data(void) {
    int rc;
    LOG_INF("[%s:%d]\n", __func__, __LINE__);        
    while(!iotex_mqtt_is_bulk_upload_over()) {    
        rc = get_block_size();
        iotex_local_storage_hist(SID_MQTT_BULK_UPLOAD_DATA, mqttPubBuf, rc, get_his_block());
        rc = iotex_mqtt_publish_data(&client, 0, mqttPubBuf, rc);
        LOG_INF("mqtt_bulk_upload: %d \n", rc);
        iotex_mqtt_inc_current_upload_count();
    }  
}

int publish_dev_ownership(char *buf, int len) {
    return iotex_mqtt_publish_ownership(&client, 0, buf, len);
}

/*  publish query package */
int publish_dev_query(char *buf, int len) {
    return iotex_mqtt_publish_query(&client, 0, buf, len);
}

void animation_work_fn(struct k_work *work) {
    if (atomic_get(&stopAnimation)) {
        return;
    }
    sta_Refresh();
    k_work_schedule_for_queue(&application_work_q, &animation_work, K_SECONDS(1));
}

void stopAnimationWork(void) {
    atomic_set(&stopAnimation, 1);
}

/**@brief Initializes and submits delayed work. */
static void work_init(void) {
    k_work_init_delayable(&animation_work, animation_work_fn);
}

/**@brief Configures modem to provide LTE link. Blocks until link is
 * successfully established.
 */
static void modem_configure(void) {
    int err;

    LOG_INF("Connecting to LTE network. ");
    LOG_INF("This may take several minutes.\n");  
    err = lte_lc_psm_req(true);
    if (err) {
        LOG_ERR("lte_lc_psm_req erro:%d\n", err);
        error_handler(ERROR_LTE_LC, err);
    }
    err = lte_lc_init_and_connect();
    if (err) {
        lte_lc_deinit();
        LOG_INF("modem fallback\n");
        anotherWorkMode();
        err = lte_lc_init_and_connect();
        if (err) {
            LOG_ERR("LTE link could not be established, system will reboot.\n");
            sys_reboot(0);
        }
    }        
    LOG_INF("Connected to LTE network\n");
    /* ui_led_active(LTE_CONNECT_MASK,1); */
    sta_SetMeta(LTE_LINKER, STA_LINKER_ON);
}

void handle_bsdlib_init_ret(void) {
#if defined(CONFIG_BSD_LIBRARY)
    int ret = bsdlib_get_init_ret();

    /* Handle return values relating to modem firmware update */
    switch (ret) {
    case MODEM_DFU_RESULT_OK:
        LOG_INF("MODEM UPDATE OK. Will run new firmware");
        sys_reboot(SYS_REBOOT_COLD);
        break;
    case MODEM_DFU_RESULT_UUID_ERROR:
    case MODEM_DFU_RESULT_AUTH_ERROR:
        LOG_ERR("MODEM UPDATE ERROR %d. Will run old firmware", ret);
        sys_reboot(SYS_REBOOT_COLD);
        break;
    case MODEM_DFU_RESULT_HARDWARE_ERROR:
    case MODEM_DFU_RESULT_INTERNAL_ERROR:
        LOG_ERR("MODEM UPDATE FATAL ERROR %d. Modem failiure", ret);
        sys_reboot(SYS_REBOOT_COLD);
        break;
    default:
        break;
    }
#endif /* CONFIG_BSD_LIBRARY */
}

/*  Sample and store to nv flash */
static void sampling_and_store_sensor_data(void) {
    /* Data sampling mode */ 
    if (iotex_mqtt_is_need_sampling()) {
        /* Sampling data and save to nvs,
        when required sampling count fulfilled, start bulk upload.
        Support breakpoint resampling and breakpoint retransmission.
        */
        LOG_INF("Before...............\n");
        if (!iotex_mqtt_sampling_data_and_store(iotex_mqtt_get_data_channel())) {
            LOG_ERR("[%s:%d] Sampling and store data failed!\n", __func__, __LINE__);
            return;
        }
#ifdef CONFIG_DEBUG_MQTT_CONFIG
        LOG_INF("[%s:%d]: Sampling count: %u\n", __func__, __LINE__, iotex_mqtt_get_current_sampling_count() + 1);
#endif

        /* Required sampling count is fulfilled */
        if (iotex_mqtt_inc_current_sampling_count()) {
        }
    }
    /* Data upload mode */
    else {
        bulk_publish_sersor_data();
    }
}

void stopMqtt(void) {
    mqtt_disconnect(&client);
}
void keyWakeup(void) {
    if((devRegGet() == DEV_REG_STOP) && (!atomic_get(&keyWaitFlg))) {
        if (isComninationKeys(KB_UP_KEY|KB_DOWN_KEY)) {
            atomic_set(&keyWaitFlg,1);
            k_wakeup(mainThreadID);
            ctrlOLED(true);
        }
    }
}

bool isKeyWakeFlg(void) {
    return (atomic_get(&keyWaitFlg));
}
/*
    time  unit second
*/
int  eventPolling(unsigned int time, struct pollfd *fds, struct mqtt_client *client) {
    unsigned int waitCounts = time * 1000/CONFIG_MAIN_BASE_TIME;
    int err = 0;

    while (waitCounts--) {
        err = poll(fds, 1, CONFIG_MAIN_BASE_TIME);
        if (err < 0) {
            LOG_ERR("ERROR: poll %d\n", errno);
            err = -1;
            break;
        }
        if ((fds->revents & POLLIN) == POLLIN) {
            err = mqtt_input(client);
            if (err != 0) {
                LOG_ERR("ERROR: mqtt_input %d\n", err);
                err = -1;
                break;
            }
        }
        if ((fds->revents & POLLERR) == POLLERR) {
            LOG_ERR("POLLERR\n");
            err = -1;
            break;
        }
        if ((fds->revents & POLLNVAL) == POLLNVAL) {
            LOG_ERR("POLLNVAL\n");
            err = -1;
            break;
        }
        err = mqtt_live(client);
        if (err != 0 && err != -EAGAIN) {
            LOG_ERR("ERROR: mqtt_live %d\n", err);
            err = -1;
            break;
        }   
    }
    return  err;
}

int psmWork(void) {
    int ret;

    if(atomic_get(&keyWaitFlg)){ 
        LOG_INF("wakeup and waiting for download\n");
        hintString(htstartReconf, HINT_TIME_FOREVER);
        eventPolling(300, &fds, &client);
        atomic_set(&keyWaitFlg,0);
    }
    LOG_INF("upload sensor data\n");
    uploadSensorData();
    ret = k_sleep(K_MSEC(200));
    if(ret) {
        if(atomic_get(&keyWaitFlg)){
            LOG_INF("wakeup after data pubs\n");
            hintString(htstartReconf, HINT_TIME_FOREVER);
            eventPolling(300, &fds, &client);
            atomic_set(&keyWaitFlg,0);
        }
    }
    mqtt_disconnect(&client);
    if(iotex_mqtt_get_upload_period() > 30)
        gpsSleep();
    LOG_INF("start sleep\n");
    setModemSleep(1);
    ret = k_sleep(K_SECONDS(1));
    if(ret) {
        if(atomic_get(&keyWaitFlg)){
            LOG_INF("wakeup after mqtt disconnect\n"); 
            hintString(htstartMqtt, HINT_TIME_FOREVER);
            lte_lc_psm_req(false);
            return 1;
        }
    }
    lte_lc_psm_req(true);
    if(iotex_mqtt_get_upload_period() > 30)
        ret = k_sleep(K_SECONDS(iotex_mqtt_get_upload_period()-getSatelliteSearchingTime()));
    else
        ret = k_sleep(K_SECONDS(iotex_mqtt_get_upload_period()-1));
    if(ret) {
        if(atomic_get(&keyWaitFlg)){
            LOG_INF("wakeup after psm\n"); 
            hintString(htstartMqtt, HINT_TIME_FOREVER);
            lte_lc_psm_req(false);
            return 1;
        }
    }
    gpsWakeup();
    if(iotex_mqtt_get_upload_period() > 30) {
        ret = searchingSatelliteTime();  
        if(atomic_get(&keyWaitFlg)){
            LOG_INF("wakeup after gps start\n");
            hintString(htstartMqtt, HINT_TIME_FOREVER);
            lte_lc_psm_req(false);
            return 1;
        } 
    }
    lte_lc_psm_req(false);  
    LOG_INF("wake up\n"); 
    setModemSleep(0);
    atomic_set(&pebbleStartup,0);
    return 0;   
}

void main(void) {
    int err, errCounts = 0;
    
	err = nrf_modem_lib_init();
	if (err < 0) {
		LOG_ERR("Modem library init failed, err: %d", err);
		return err;
	}
    LOG_INF("APP %s  %s started\n", IOTEX_APP_NAME, RELEASE_VERSION);
    mainThreadID = k_current_get(); 
    k_work_queue_start(&application_work_q, application_stack_area,K_THREAD_STACK_SIZEOF(application_stack_area),K_LOWEST_APPLICATION_THREAD_PRIO, NULL);
    /*  open watchdog */
    if (IS_ENABLED(CONFIG_WATCHDOG)) {
        watchdog_init_and_start();
    }
    /*   init ECDSA */
    /*  i2c speed 400kbps  */
    setI2Cspeed(2);
    /* HAL init, notice gpio must be the first (to set IO_POWER_ON on )*/
    iotex_local_storage_init();
    /*  read ecdsa key pair */
    if (err = pebble_crypto_init()) {
        LOG_ERR("check ecc key error: %d ", err);
        LOG_ERR("system will not startup");
        return;
    }
    /*  init gpio */
    iotex_hal_gpio_init();
    /*  init  onchip adc */
    iotex_hal_adc_init();
    /*  init GPS */
    exGPSInit();
    /* Iotex Init BME680 */
    iotex_bme680_init();
    /* Iotex Init TSL2572 */
    iotex_TSL2572_init(GAIN_1X); 
    /*  iotex keyboard */
    iotex_key_init();
    /*  init worker queue */
    work_init();
    initOTA();
    /*  init oled */
    ssd1306_init();
    /* Iotex Init ICM42605 */
    iotex_icm_chip_init();
    /*  system  menu */
    MainMenu();
    /*  OTA upgrade  */
    appEntryDetect();
    /*  work queue of the status bar  */
    k_work_schedule_for_queue(&application_work_q, &animation_work, K_MSEC(10));
    /*  LTE-M / NB-IOT network attach */
    modem_configure();
    handle_bsdlib_init_ret();
    /*  status bar refresh */
    sta_Refresh();
    initNTP();
    while (true) {
        if ((err = iotex_mqtt_client_init(&client, &fds))) {
            errCounts++;
            if(errCounts < 4){
                LOG_ERR("**** %s reconnection ****\n",reconnectReminder[errCounts]);
                continue;
            }
            LOG_ERR("ERROR: mqtt_connect %d, rebooting...\n", err);
            k_sleep(K_MSEC(500));
            sys_reboot(0);
            break;
        }

        errCounts = 0;
        if (!iotexDevBinding(&fds,&client)) {
            if(psmWork())
                continue;
        }
        syncNTPTime();
        if (devRegGet() != DEV_REG_STOP) {
            devRegSet(DEV_REG_START);
            pebbleBackGround(0);
        }
    }

    LOG_INF("Disconnecting MQTT client...\n");
    err = mqtt_disconnect(&client);
    if (err) {
        LOG_ERR("Could not disconnect MQTT client. Error: %d\n", err);
    }
    iotex_hal_gpio_set(LED_RED, LED_ON);
    k_sleep(K_MSEC(500));
    iotex_hal_gpio_set(LED_RED, LED_OFF);
    k_sleep(K_MSEC(500));
    iotex_hal_gpio_set(LED_RED, LED_OFF);
    k_sleep(K_MSEC(500));
    sys_reboot(0);
}
```

## src/certificates.h
```c
/*
 * Copyright (c) 2018 Nordic Semiconductor ASA
 *
 * SPDX-License-Identifier: LicenseRef-BSD-5-Clause-Nordic
 */
#ifndef _CERTIFICATES_H_
#define _CERTIFICATES_H_

#define NRF_CLOUD_CLIENT_ID "my-client-id"

#define NRF_CLOUD_CLIENT_PRIVATE_KEY \
    "-----BEGIN RSA PRIVATE KEY-----\n" \
    "MIIEpQIBAAKCAQEAsgDSE0WtdxHNOvjwVql7ilXehbpo8DcnTEIsZyKt96dpqaOs\n" \
    "/fhv5i9bHA5YkF2sJdD0L2P1e4B0O+k8/+SJFQKSp0DRfdOnxNFoYG96wVyw/kPo\n" \
    "TdhzFFIIv1B1gRscA5+ch29fHTVvzsnYd3ZupnANa6z8EATsD8qowfdKrAQwzBWt\n" \
    "MaYpvZ4D0uCFPJ85b947l0SiFEAI1a6kNNvHNxRBr6YUVKX+p7az0Q+2TTvM55lH\n" \
    "7Ydrfzt3/dd8rF7jMsSh8WJemCDLxFbWp7h/C1h00ZZpfFAt3bUUpEKbymLpKAPe\n" \
    "4PyfAH2FXi8eK0nwR3k8bGZa4seBffKijdEdkQIDAQABAoIBAAI4EmZdGwF9/lH6\n" \
    "4nwiFsEtut1t6nr8JQhFVupeO074DlAoEzMDUtnKw1cBMsdx84BxL2ob0+abPle0\n" \
    "26bRAYh6hLuDClmINvI0LhntqdkZP7ebvxyhUyXws902spBOdzXwWnIxyDzD+sXY\n" \
    "LFOo7U4z3Wb3PBkzBoJX42yvmYW1blLFhrb7KRjh4H4lVA2ovGtNlTbLOmbmoDCB\n" \
    "RDWreAAcgSJhAlJB97Xw9EP0cxnIEgaCShE3MiqpYp4SZ7dWSot/uZ7IbmKBhUIC\n" \
    "mz3ItmAA8ScVGxof1lEVaw1uLh3lRf1LuK4YS1UmPWINb+mCdeiAwr37vtsmYiZ/\n" \
    "mH6VWeUCgYEA6I4sxGxN1ULeE+TEFHhHJOqdVcLouhmNS9Y5J1OTXsVGFR43ZJeB\n" \
    "8qTuCC/bUd4a1IG3PNqoVU71ftA+AwetYy6nV0+9UNi5iaisd9F+nmMO81JvCeLp\n" \
    "00nmVPL7x/GLum1enG85KDLciXUouVkJsohaAo5upGG5bnXuOn6Cir8CgYEAw/LB\n" \
    "Rp1GwiK1eru4G9r4fImjwGyBIegzzoEKGeJS2gF4jg3ItZvWCOfxBtcwTSylkwHU\n" \
    "E2AvLqx/OjW9QzPjW7v2FiTrMIxbvRXBKmLuT/uJYObJ8JqsFzvXes4H/N78MV7t\n" \
    "Ve3a1KqrKFArsUsVfu7ahwd9PyddQXFhKGU1+68CgYEAl6lA4MiQ6ee11Nt4VLEs\n" \
    "FJM9EFUQWW2YjECk/VSv4zpcPiF6louIH6oX4hbzvSxP6w69ZV5kMV5RE+bSyj8T\n" \
    "gH9IetRx7muodHIgJ/Pj039enKjB6XymaTjkkbn1IawRJ/9zmCmg6OpikPJrIJVE\n" \
    "kb4ClXA2D9X7jGI0fslKcRkCgYEAmMPrtzfq8HPK9PLhKKZg0Acm6WAulNbJfRfR\n" \
    "Xji6y0gWSvmoHx5tkefyW5jtCV3jgGcOhkSYxFSrpCA9e+U6PkyeIMmLqv/ijdom\n" \
    "DPuwPB8pDakgizqrLDn1VsLGK3lVONB/TFzyHJcqdXV7eu/ExH9HU7qdBN2VsO3K\n" \
    "B4pQufUCgYEAsk0+SGUxFa0GtDtg89+GQatVQL4tP2PYJr0RtDrDM5xRa/NZ2EVl\n" \
    "12jpBVOJnFhgu9rNnP2+7DdwzCaTK0ge50Xdb38YmQZ1nhAfnosMtEVfa6zZwcGq\n" \
    "ZxP6abiAL01p0Cy/gTKPdMb3X9ljtYWMK1DsNDJsKiYaDrGPD5Pi7OI=\n" \
    "-----END RSA PRIVATE KEY-----\n"

#define NRF_CLOUD_CLIENT_PUBLIC_CERTIFICATE \
    "-----BEGIN CERTIFICATE-----\n" \
    "MIIDWjCCAkKgAwIBAgIVAJrzhhchG3BTvS+77wWcijzbGazRMA0GCSqGSIb3DQEB\n" \
    "CwUAME0xSzBJBgNVBAsMQkFtYXpvbiBXZWIgU2VydmljZXMgTz1BbWF6b24uY29t\n" \
    "IEluYy4gTD1TZWF0dGxlIFNUPVdhc2hpbmd0b24gQz1VUzAeFw0yMTAzMTQwNjU3\n" \
    "NThaFw00OTEyMzEyMzU5NTlaMB4xHDAaBgNVBAMME0FXUyBJb1QgQ2VydGlmaWNh\n" \
    "dGUwggEiMA0GCSqGSIb3DQEBAQUAA4IBDwAwggEKAoIBAQCyANITRa13Ec06+PBW\n" \
    "qXuKVd6FumjwNydMQixnIq33p2mpo6z9+G/mL1scDliQXawl0PQvY/V7gHQ76Tz/\n" \
    "5IkVApKnQNF906fE0Whgb3rBXLD+Q+hN2HMUUgi/UHWBGxwDn5yHb18dNW/Oydh3\n" \
    "dm6mcA1rrPwQBOwPyqjB90qsBDDMFa0xpim9ngPS4IU8nzlv3juXRKIUQAjVrqQ0\n" \
    "28c3FEGvphRUpf6ntrPRD7ZNO8znmUfth2t/O3f913ysXuMyxKHxYl6YIMvEVtan\n" \
    "uH8LWHTRlml8UC3dtRSkQpvKYukoA97g/J8AfYVeLx4rSfBHeTxsZlrix4F98qKN\n" \
    "0R2RAgMBAAGjYDBeMB8GA1UdIwQYMBaAFIqcw071K56oZlRIV/wchLHqxUMHMB0G\n" \
    "A1UdDgQWBBQwB3KM2nTpqiPx9qYgX54xxck+2zAMBgNVHRMBAf8EAjAAMA4GA1Ud\n" \
    "DwEB/wQEAwIHgDANBgkqhkiG9w0BAQsFAAOCAQEACQ8JrQXDDzXjbJcAkoAS2YSR\n" \
    "35rRUJKlgT2NweubgMb6hzp4WW+hq1dI4h85Dk4A6+HQA3SKGIMP/J3c4F7gvRgY\n" \
    "RRY67up/ZDiFNyTreTNejxSIYaDOKpmhO2k43RfgGMbdF8hdTEpYPTyd8RlHy+NR\n" \
    "WVNOlCTLdXULPKwSeHdPU2N+KHGvb4wv5CbmnqCg/UQKa96QyjGBom/t07CF0gvB\n" \
    "9knVPgA93orGLjJNtL4J2yQu3hzrlIcWGtm9ZIsxV5wTZCObRhjuDLs5HBt9QwJc\n" \
    "xSiJYesY9Xg8jlT7bcPJj6gwJKhuU6xeKxU5YrPZc1px3Osw3/aZzFP1doYwBg==\n" \
    "-----END CERTIFICATE-----\n"

#define NRF_CLOUD_CA_CERTIFICATE \
    "-----BEGIN CERTIFICATE-----\nMIIDQTCCAimgAwIBAgITBmyfz5m/jAo54vB4ikPmljZbyjANBgkqhkiG9w0BAQsF\nADA5MQswCQYDVQQGEwJVUzEPMA0GA1UEChMGQW1hem9uMRkwFwYDVQQDExBBbWF6\nb24gUm9vdCBDQSAxMB4XDTE1MDUyNjAwMDAwMFoXDTM4MDExNzAwMDAwMFowOTEL\nMAkGA1UEBhMCVVMxDzANBgNVBAoTBkFtYXpvbjEZMBcGA1UEAxMQQW1hem9uIFJv\nb3QgQ0EgMTCCASIwDQYJKoZIhvcNAQEBBQADggEPADCCAQoCggEBALJ4gHHKeNXj\nca9HgFB0fW7Y14h29Jlo91ghYPl0hAEvrAIthtOgQ3pOsqTQNroBvo3bSMgHFzZM\n9O6II8c+6zf1tRn4SWiw3te5djgdYZ6k/oI2peVKVuRF4fn9tBb6dNqcmzU5L/qw\nIFAGbHrQgLKm+a/sRxmPUDgH3KKHOVj4utWp+UhnMJbulHheb4mjUcAwhmahRWa6\nVOujw5H5SNz/0egwLX0tdHA114gk957EWW67c4cX8jJGKLhD+rcdqsq08p8kDi1L\n93FcXmn/6pUCyziKrlA4b9v7LWIbxcceVOF34GfID5yHI9Y/QCB/IIDEgEw+OyQm\njgSubJrIqg0CAwEAAaNCMEAwDwYDVR0TAQH/BAUwAwEB/zAOBgNVHQ8BAf8EBAMC\nAYYwHQYDVR0OBBYEFIQYzIU07LwMlJQuCFmcx7IQTgoIMA0GCSqGSIb3DQEBCwUA\nA4IBAQCY8jdaQZChGsV2USggNiMOruYou6r4lK5IpDB/G/wkjUu0yKGX9rbxenDI\nU5PMCCjjmCXPI6T53iHTfIUJrU6adTrCC2qJeHZERxhlbI1Bjjt/msv0tadQ1wUs\nN+gDS63pYaACbvXy8MWy7Vu33PqUXHeeE6V/Uq2V8viTO96LXFvKWlJbYK8U90vv\no/ufQJVtMVT8QtPHRh8jrdkPSHCa2XV4cdFyQzR1bldZwgJcJmApzyMZFo6IQ6XU\n5MsI+yMRQ+hDKXJioaldXgjUkK642M4UwtBV8ob2xJNDd2ZhwLnoQdeXeGADbkpy\nrqXRfboQnoZsG4q5WTP468SQvvG5\n-----END CERTIFICATE-----\n"

#endif /*  #ifndef _CERTIFICATES_H_ */
```

## src/ver.h
```c
#ifndef __APP_VERSION__
#define __APP_VERSION__

/*  hardware board version */
#define HW_VERSION "3.0"

/*  nordic sdk version */
#define SDK_VERSION "1.4.0"

#define  IOTEX_APP_NAME  "Riverrock"

#define  RELEASE_VERSION    "1.0.15"

/*  application version */
#define IOTEX_APP_VERSION IOTEX_APP_NAME" "RELEASE_VERSION

#define APP_VERSION_INFO HW_VERSION"_"SDK_VERSION"_"IOTEX_APP_VERSION">"

/*  upload period, second */
#define SENSOR_UPLOAD_PERIOD       300

#endif /*  #ifndef __APP_VERSION__ */
```
